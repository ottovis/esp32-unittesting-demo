## test_qemu/sdkconfig.defaults
```kconfig
CONFIG_ESP_TASK_WDT_EN=n
CONFIG_IDF_TARGET="esp32"
CONFIG_UNITY_ENABLE_IDF_TEST_RUNNER=y
CONFIG_ESPTOOLPY_FLASHSIZE_8MB=y
CONFIG_ESPTOOLPY_FLASHSIZE="8MB"
```
